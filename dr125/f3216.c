/*
 * f3216.c
 *
 *      Author: LiberdaA
 */

#include <stdint.h>
#include <avr/pgmspace.h>
#include "f3216.h"
#include "sh1106_drv.h"


#define DISP_F3216_BYTES_PER_FONT  64


Font_t Font3216 = {
		.id = DISP_FONT3216,
		.height = 32,
		.width = 16,
		.spacing = 2,
		.drawCharFont = DISP_DrawCharFont3216
};


//todo: what about static
// [number of fonts][bytes per font]
const uint8_t Font3216Glyphs[11][DISP_F3216_BYTES_PER_FONT] PROGMEM = {

    {0x00,0x00,0x00,0x00,0x00,0x00,0x00,0x00,0x3F,0xFF,0xFF,0xFC,0x3F,0xFF,0xFF,0xFC,    /*"0",0*/

    0x30,0x00,0x00,0x0C,0x30,0x00,0x00,0x0C,0x30,0x00,0x00,0x0C,0x30,0x00,0x00,0x0C,
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    0x00,0x00,0x00,0x00,0x00,0x00,0x00,0x00,0x00,0x00,0x00,0x00,0x00,0x00,0x00,0x00}

};


void DISP_DrawCharFont3216(uint16_t x, uint16_t y, uint8_t ascii, DISP_FontMode_t fntMode)
{
    uint8_t i, j, y0 = y;
    uint8_t tmpChar = 0;
    uint8_t ch = 0;


    if (ascii < '0' | ascii > ':')
    	return;

    ch = ascii - '0';
    for(i = 0; i < DISP_F3216_BYTES_PER_FONT; i++)
    {
    	tmpChar = pgm_read_byte(&Font3216Glyphs[ch][i]);
        for(j = 0; j < 8; j++)  // scanning all bits in a current byte
        {
            if(tmpChar & 0x80) SH1106_setPixel(x, y, 1);	//todo: add mode: positive, negative
            else SH1106_setPixel(x, y, 0);

            tmpChar <<= 1;
            y++;
            if((y - y0) == Font3216.height)
            {
                y = y0;
                x++;
                break;  // if height of the glyph is bigger than by 8,
                        // skip the rest of bits in the current byte, and load next one
            }
        }
    }

}

