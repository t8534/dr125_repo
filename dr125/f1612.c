/*
 * f1612.c
 *
 *      Author: LiberdaA
 */


#include <stdint.h>
#include <avr/pgmspace.h>
#include "f1612.h"
#include "sh1106_drv.h"


#define DISP_F1612_BYTES_PER_FONT  32


Font_t Font1612 = {
		.id = DISP_FONT1612,
		.height = 16,
		.width = 12,
		.spacing = 4,
		.drawCharFont = DISP_DrawCharFont1612
};


//todo what about static
const uint8_t Font1612Glyphs[11][DISP_F1612_BYTES_PER_FONT] PROGMEM = {

    {0x00,0x00,0x3F,0xFC,0x3F,0xFC,0x30,0x0C,0x30,0x0C,0x30,0x0C,0x30,0x0C,0x30,0x0C,

    0x30,0x0C,0x30,0x0C,0x30,0x0C,0x30,0x0C,0x30,0x0C,0x3F,0xFC,0x3F,0xFC,0x00,0x00},/*"0",0*/
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    {0x00,0x00,0x00,0x00,0x00,0x00,0x00,0x00,0x00,0x00,0x00,0x00,0x00,0x00,0x18,0x30,

    0x18,0x30,0x00,0x00,0x00,0x00,0x00,0x00,0x00,0x00,0x00,0x00,0x00,0x00,0x00,0x00},/*":",10*/

};


void DISP_DrawCharFont1612(uint16_t x, uint16_t y, uint8_t ascii, DISP_FontMode_t fntMode)
{
    uint8_t i, j, y0 = y;
    uint8_t tmpChar = 0;
    uint8_t ch = 0;


    if (ascii < '0' | ascii > ':')
    	return;

    ch = ascii - '0';
    for(i = 0; i < DISP_F1612_BYTES_PER_FONT; i++)
    {
    	tmpChar = pgm_read_byte(&Font1612Glyphs[ch][i]);
		for(j = 0; j < 8; j++)  // scanning all bits in a current byte
        {
            if(tmpChar & 0x80) SH1106_setPixel(x, y, 1);	//todo: add mode: positive, negative
            else SH1106_setPixel(x, y, 0);

            tmpChar <<= 1;
            y++;
            if((y - y0) == Font1612.height)
            {
                y = y0;
                x++;
                break;  // if height of the glyph is bigger than by 8,
                        // skip the rest of bits in the current byte, and load next one
            }
        }
    }

}

